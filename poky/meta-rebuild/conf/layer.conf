## poky/meta-rebuild/conf/layer.conf
```bitbake
# We have a conf and classes directory, add to BBPATH
BBPATH .= ":${LAYERDIR}"

# We have recipes-* directories, add to BBFILES
BBFILES += "${LAYERDIR}/recipes*/*/*.bb \
	${LAYERDIR}/recipes*/*/*.bbappend"

BBFILE_COLLECTIONS += "rebuild"
BBFILE_PATTERN_rebuild = "^${LAYERDIR}/"
BBFILE_PRIORITY_rebuild = "13"

IMAGE_INSTALL_append = " update-unengine"
```
